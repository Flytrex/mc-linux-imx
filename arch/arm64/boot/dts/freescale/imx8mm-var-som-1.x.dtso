// SPDX-License-Identifier: (GPL-2.0+ OR MIT)
/*
 * Device tree overlay to support the VAR-SOM-MX8M-MINI 1.x
 *
 * Copyright 2025 Variscite Ltd.
 */

/dts-v1/;
/plugin/;

&bluetooth_iw61x {
	status = "disabled";
};
